## CMakeLists.txt
```
#
# Copyright (c) 2022 Nordic Semiconductor ASA
#
# SPDX-License-Identifier: LicenseRef-Nordic-5-Clause
#

cmake_minimum_required(VERSION 3.20.0)

find_package(Zephyr REQUIRED HINTS $ENV{ZEPHYR_BASE})

# Set the nRF5340 Audio version. x.x.99 indicates master branch/cutting edge
project(NRF5340_AUDIO VERSION 0.5.99)

string(TIMESTAMP NRF5340_AUDIO_CORE_APP_COMP_DATE "%a %b %d %H:%M:%S %Y")

# Target sources below are specific to the nRF5340 Audio DK HW
target_sources(app PRIVATE
    src/main.c
)

# Include application events and configuration headers
zephyr_library_include_directories(
    src/audio
    src/bluetooth
    src/utils
    src/utils/macros
    src/io
    src/synthesizer
)

# Application sources
add_subdirectory(src/audio)
add_subdirectory(src/bluetooth)
add_subdirectory(src/utils)
add_subdirectory(src/io)
add_subdirectory(src/synthesizer)
```

## Kconfig
```
#
# Copyright (c) 2018 Nordic Semiconductor ASA
#
# SPDX-License-Identifier: LicenseRef-Nordic-5-Clause
#

menuconfig NRF5340_AUDIO
	 bool "nRF5340 Audio [EXPERIMENTAL]"
	 select EXPERIMENTAL

if NRF5340_AUDIO

choice NRF5340_AUDIO_TRANSPORT_MODE
	prompt "Choose BIS or CIS for ISO transport"
	default TRANSPORT_CIS

config TRANSPORT_BIS
	bool "Use BIS (Broadcast Isochronous Stream)"

config TRANSPORT_CIS
	bool "Use CIS (Connected Isochronous Stream)"

endchoice

#----------------------------------------------------------------------------#
rsource "src/audio/Kconfig"
rsource "src/bluetooth/Kconfig"
rsource "src/utils/Kconfig"
rsource "src/synthesizer/Kconfig"
rsource "src/io/Kconfig"

#----------------------------------------------------------------------------#
menu "Logging"

config LOG_MAIN_LEVEL
	int "Log level for main file"
	default 3

config PRINT_STACK_USAGE_MS
	depends on THREAD_ANALYZER && INIT_STACKS
	int "Print stack usage every x milliseconds"
	default 5000

endmenu # Log levels

#----------------------------------------------------------------------------#
endif # NRF5340_AUDIO

source "Kconfig.zephyr"
```

## sample.yaml
```
sample:
  name: nRF5340 Audio
  description: LE Audio sample
common:
  integration_platforms:
      - nrf5340_audio_dk_nrf5340_cpuapp
      - nrf5340dk_nrf5340_cpuapp
tests:
  applications.nrf5340_audio.gateway:
    build_only: true
    platform_allow: nrf5340_audio_dk_nrf5340_cpuapp nrf5340dk_nrf5340_cpuapp thingy53_nrf5340_cpuapp
    platform_exclude: nrf5340_audio_dk_nrf5340_cpuapp_ns
    tags: ci_build
    extra_args: CMAKE_BUILD_TYPE=RELEASE DEV_GATEWAY=ON
```

## prj.conf
```kconfig
#
# Copyright (c) 2022 Nordic Semiconductor ASA
#
# SPDX-License-Identifier: LicenseRef-Nordic-5-Clause
#

# General
CONFIG_NRF5340_AUDIO=y
CONFIG_REBOOT=y
CONFIG_MAIN_THREAD_PRIORITY=10
CONFIG_MAIN_STACK_SIZE=1940

# Disable Zephyr HCI Vendor-Specific extensions
CONFIG_BT_HCI_VS_EXT=n

# As long as thread names are used, config must be set to "y"
CONFIG_THREAD_NAME=y

# Bluetooth
CONFIG_BT=y
CONFIG_BT_PRIVACY=n
CONFIG_BT_GATT_CLIENT=y
CONFIG_BT_GATT_DYNAMIC_DB=y
CONFIG_BT_CENTRAL=y
CONFIG_BT_BROADCASTER=y
CONFIG_BT_VCS_CLIENT=y
CONFIG_BT_DEVICE_NAME="LE AUDIO DEMO"
CONFIG_SYSTEM_WORKQUEUE_STACK_SIZE=4096

# Make sure we have enough space to receive one frame of encoded data
# The values set below are extended for higher BLE transmission capability
CONFIG_BT_ISO_RX_MTU=190
CONFIG_BT_ISO_TX_MTU=190
CONFIG_BT_L2CAP_TX_BUF_COUNT=6
CONFIG_BT_RX_STACK_SIZE=2000
CONFIG_BT_BUF_ACL_RX_SIZE=259

# Not supported on Packetcraft controller
CONFIG_BT_ATT_ENFORCE_FLOW=n

# Only do pairing without bonding
CONFIG_BT_BONDABLE=n
CONFIG_BT_AUDIO=y
CONFIG_BT_EXT_ADV=y
CONFIG_BT_PER_ADV=y
CONFIG_BT_ISO_UNICAST=y
CONFIG_BT_ISO_BROADCASTER=y
CONFIG_BT_ISO_SYNC_RECEIVER=y

# Temporary, enable the following to meet BT_ISO dependencies
CONFIG_BT_OBSERVER=y

# Audio sync timer
CONFIG_NRFX_TIMER1=y
CONFIG_NRFX_DPPI=y

# Need to turn on SMP when involving services in LE audio profiles
CONFIG_BT_SMP=y

# Temporarily disabled connetion parameter and PHY update
CONFIG_BT_GAP_AUTO_UPDATE_CONN_PARAMS=n
CONFIG_BT_AUTO_PHY_UPDATE=n
CONFIG_BT_AUTO_DATA_LEN_UPDATE=n

# Required for certain DSP functions
CONFIG_NEWLIB_LIBC=y # <math.h>
CONFIG_FPU=y

# Avoid multi-build system build network core firmware
CONFIG_NCS_INCLUDE_RPMSG_CHILD_IMAGE=n

# Dual headsets demo requires gateway to establish two ACL connections
# and two ISO connections
CONFIG_BT_MAX_CONN=2
CONFIG_BT_ISO_MAX_CHAN=2
CONFIG_BT_MAX_PAIRED=2

CONFIG_LC3_ENC_CHAN_MAX=2

# application board spesific
CONFIG_BUTTON_DEBOUNCE_MS=30
CONFIG_MAX_NOTES=5
```

## overlay-central.conf
```kconfig
#
# Copyright (c) 2022 Nordic Semiconductor ASA
#
# SPDX-License-Identifier: LicenseRef-Nordic-5-Clause
#

# General
CONFIG_BT_CENTRAL=y
CONFIG_BT_BROADCASTER=y
CONFIG_BT_VCS_CLIENT=y
CONFIG_BT_DEVICE_NAME="LE AUDIO DEMO"
CONFIG_SYSTEM_WORKQUEUE_STACK_SIZE=4096

# USB related configs
CONFIG_USB_DEVICE_STACK=y

# Net buf options needed for USB stack
CONFIG_NET_BUF=y
# Size of 1ms of stereo audio in bytes (48kHz, 16 bit)
CONFIG_NET_BUF_USER_DATA_SIZE=192

# USB audio related configs
CONFIG_USB_DEVICE_AUDIO=y
## TODO: Nordic VID, change accordingly
CONFIG_USB_DEVICE_VID=0x1915
## TODO: Change for final product
CONFIG_USB_DEVICE_PID=0x530A
CONFIG_USB_DEVICE_PRODUCT="DEMO USB Audio"
CONFIG_USB_DEVICE_MANUFACTURER="Nordic Semiconductors AS"

# Dual headsets demo requires gateway to establish two ACL connections
# and two ISO connections
CONFIG_BT_MAX_CONN=2
CONFIG_BT_ISO_MAX_CHAN=2
CONFIG_BT_MAX_PAIRED=2

CONFIG_LC3_ENC_CHAN_MAX=2

CONFIG_EXPLICIT_DSP_INSTRUCTIONS=y
```

## overlay-debug.conf
```kconfig
#
# Copyright (c) 2022 Nordic Semiconductor ASA
#
# SPDX-License-Identifier: LicenseRef-Nordic-5-Clause
#

# General
CONFIG_DEBUG=y
CONFIG_DEBUG_INFO=y
CONFIG_ASSERT=y
CONFIG_STACK_USAGE=y
CONFIG_THREAD_RUNTIME_STATS=y
CONFIG_STACK_SENTINEL=y
CONFIG_INIT_STACKS=y

# Avoid redundant warnings for endpoint setting in USB stack
CONFIG_USB_DRIVER_LOG_LEVEL_ERR=y
CONFIG_USB_DEVICE_LOG_LEVEL_ERR=y

# Uart driver
CONFIG_SERIAL=y

# Logging
CONFIG_LOG=y
CONFIG_LOG_MODE_DEFERRED=n # buffered (y) or unbuffered, usefull to have unbuffered to trace os crash
CONFIG_LOG_BACKEND_UART=y
CONFIG_LOG_BACKEND_RTT=n
CONFIG_LOG_DEFAULT_LEVEL=4
CONFIG_NEWLIB_LIBC_FLOAT_PRINTF=y
CONFIG_LOG_TAG_MAX_LEN=2
CONFIG_LOG_TAG_DEFAULT="--"

# Console related defines
CONFIG_CONSOLE=y
CONFIG_RTT_CONSOLE=y
CONFIG_UART_CONSOLE=y

# Shell related defines
CONFIG_SHELL=y
CONFIG_KERNEL_SHELL=y
CONFIG_USE_SEGGER_RTT=y

## Disable logs on RTT
CONFIG_SHELL_RTT_INIT_LOG_LEVEL_NONE=y
CONFIG_SHELL_BACKEND_RTT=y
CONFIG_SHELL_BACKEND_SERIAL=n
CONFIG_SHELL_VT100_COLORS=y
CONFIG_SHELL_STACK_SIZE=1024
CONFIG_SHELL_CMD_BUFF_SIZE=128

## Reduce shell memory usage
CONFIG_SHELL_WILDCARD=n
CONFIG_SHELL_HELP_ON_WRONG_ARGUMENT_COUNT=n
CONFIG_SHELL_STATS=n
CONFIG_SHELL_CMDS=n
CONFIG_SHELL_HISTORY=y

# Turn off default shell commands
CONFIG_I2C_SHELL=n
CONFIG_HWINFO_SHELL=n
CONFIG_CLOCK_CONTROL_NRF_SHELL=n
CONFIG_DEVICE_SHELL=n

# Enable BT debug
CONFIG_BT_DEBUG_LOG=y
CONFIG_BT_LOG_LEVEL_WRN=y

# Logging
CONFIG_LOG_MAIN_LEVEL=4
CONFIG_LOG_BLE_LEVEL=4

# Enable CPU tracing
CONFIG_CPU_LOAD=y
CONFIG_CPU_LOAD_LOG_INTERVAL=10000
CONFIG_CPU_LOAD_LOG_PERIODIC=y
```

## overlay-release.conf
```kconfig
#
# Copyright (c) 2022 Nordic Semiconductor ASA
#
# SPDX-License-Identifier: LicenseRef-Nordic-5-Clause
#

# General
CONFIG_DEBUG=n
CONFIG_ASSERT=n
CONFIG_STACK_USAGE=n
CONFIG_THREAD_MONITOR=n
CONFIG_SERIAL=n
CONFIG_CONSOLE=n
CONFIG_PRINTK=n
CONFIG_UART_CONSOLE=n
```

## src/main.c
```c
/*
 * Copyright (c) 2023 Nordic Semiconductor ASA
 *
 * SPDX-License-Identifier: Apache-2.0
*/

#include <string.h>
#include <zephyr/device.h>
#include <zephyr/kernel.h>
#include "nrfx_clock.h"

#ifdef CONFIG_CPU_LOAD
#include <debug/cpu_load.h>
#endif

#include "audio_process.h"
#include "audio_sync_timer.h"
#include "ble_connection.h"
#include "button.h"
#include "macros_common.h"
#include "stream_control.h"
#include "synthesizer.h"
#include "led.h"

#include <zephyr/logging/log.h>
LOG_MODULE_REGISTER(main, CONFIG_LOG_MAIN_LEVEL);

static atomic_t _bt_is_ready = (atomic_t) false;

static void _on_bt_ready(void);
static int _hfclock_config_and_start(void);
static void _button_event_handler(void);

#define BUTTON_EVENT_STACK_SIZE 700
#define BUTTON_EVENT_PRIORITY 5
K_THREAD_DEFINE(_button_event_thread, BUTTON_EVENT_STACK_SIZE, _button_event_handler, NULL, NULL, NULL, BUTTON_EVENT_PRIORITY, 0, 0);

void main(void)
{
  int ret;

  LOG_DBG("nRF5340 APP core started");

#ifdef CONFIG_CPU_LOAD
  cpu_load_init();
#endif

  LOG_DBG("hf clock start");
  ret = _hfclock_config_and_start();
  ERR_CHK_MSG(ret, "failed to start hf clock");

  ret = led_init();
  ERR_CHK_MSG(ret, "failed to initialize leds");

  LOG_DBG("bluetooth start");
  ret = bluetooth_init(_on_bt_ready);
  ERR_CHK_MSG(ret, "failed to initialize bluetooth");

  /* wait for bluetooth to initialize */
  while (!(bool)atomic_get(&_bt_is_ready)) {
    (void)k_sleep(K_MSEC(100));
  }
  LOG_DBG("bluetooth initialization done");

  LOG_DBG("Audio sync timer init");
  ret = audio_sync_timer_init();
  ERR_CHK_MSG(ret, "failed to initialize audio sync timer");

  LOG_DBG("Audio generate init");
  audio_process_init();

  LOG_DBG("stream control start");
  ret = stream_control_start();
  ERR_CHK_MSG(ret, "failed to start stream control");

  ret = button_init();
  ERR_CHK_MSG(ret, "failed to initialize buttons");

  LOG_DBG("initialization finished");

  while (1) {
    stream_control_event_handler();
    STACK_USAGE_PRINT("main", &z_main_thread);
  }
}


static void _on_bt_ready(void)
{
  (void)atomic_set(&_bt_is_ready, (atomic_t) true);
}

static int _hfclock_config_and_start(void)
{
  int ret;

  /* Use this to turn on 128 MHz clock for cpu_app */
  ret = nrfx_clock_divider_set(NRF_CLOCK_DOMAIN_HFCLK, NRF_CLOCK_HFCLK_DIV_1);

  ret -= NRFX_ERROR_BASE_NUM;
  if (ret) {
    return ret;
  }

  nrfx_clock_hfclk_start();
  while (!nrfx_clock_hfclk_is_running()) {
  }

  return 0;
}

static void _button_event_handler(void) {
	while (1) {
		struct button_event event;
		button_event_get(&event, K_FOREVER);

		synthesizer_key_event(&event);
	}
}
```
