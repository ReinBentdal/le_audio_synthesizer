## src/input/Kconfig
```kconfig
menu "Input"

config BUTTON_DEBOUNCE_MS
    int "Button debounce time in ms"
    default 50

config LOG_BUTTON_LEVEL
    int "Log level for button.h"
    default 4

endmenu # Input
```

## src/synthesizer/Kconfig
```kconfig
rsource "dsp/Kconfig"

config MAX_NOTES
    int "Number of notes possible to play at ones"
    
    default 3
```

## src/synthesizer/dsp/Kconfig
```kconfig
menu "DSP"

menu "Log levels"

config LOG_DSP_LEVEL
	int "Log level for DSP"
	default 4

endmenu

endmenu
```
